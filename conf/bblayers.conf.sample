## conf/bblayers.conf.sample
```bitbake
# POKY_BBLAYERS_CONF_VERSION is increased each time build/conf/bblayers.conf
# changes incompatibly
POKY_BBLAYERS_CONF_VERSION = "2"

BBPATH = "${TOPDIR}"

PROJ_DIR = "${TOPDIR}\.."
BBFILES ?= ""

BBLAYERS ?= " \
  ##OEROOT##/meta-emagii \
  ##OEROOT##/meta-map-sheriffco \
  ##OEROOT##/meta-raspberrypi \
  ##OEROOT##/meta-rpi64 \
  ##OEROOT##/meta-ti/meta-ti-bsp \
  ##OEROOT##/meta-ti/meta-ti-extras \
  ##OEROOT##/meta-atmel \
  ##OEROOT##/meta-arm/meta-arm-bsp \
  ##OEROOT##/meta-arm/meta-arm-toolchain \
  ##OEROOT##/meta-arm/meta-atp \
  ##OEROOT##/meta-arm/meta-gem5 \
  ##OEROOT##/meta-arm/meta-arm \
  ##OEROOT##/meta-aws \
  ##OEROOT##/meta-browser/meta-chromium \
  ##OEROOT##/meta-clang \
  ##OEROOT##/meta-intel \
  ##OEROOT##/meta-java \
  ##OEROOT##/meta-mingw \
  ##OEROOT##/meta-python2 \
  ##OEROOT##/meta-qt5 \
  ##OEROOT##/meta-wayland \
  ##OEROOT##/meta-laird-cp/meta-laird-cp \
  ##OEROOT##/meta-rust \
  ##OEROOT##/meta-openembedded/meta-filesystems \
  ##OEROOT##/meta-openembedded/meta-gnome \
  ##OEROOT##/meta-openembedded/meta-initramfs \
  ##OEROOT##/meta-openembedded/meta-multimedia \
  ##OEROOT##/meta-openembedded/meta-networking \
  ##OEROOT##/meta-openembedded/meta-oe \
  ##OEROOT##/meta-openembedded/meta-perl \
  ##OEROOT##/meta-openembedded/meta-python \
  ##OEROOT##/meta-openembedded/meta-webserver \
  ##OEROOT##/meta-openembedded/meta-xfce \  
  ##OEROOT##/meta-swupdate \
  ##OEROOT##/meta \
  ##OEROOT##/meta-poky \
  ##OEROOT##/meta-yocto-bsp \
  "

#  Disable these layers, until we have a distro  with security and virtualization
#  ##OEROOT##/meta-security \
#  ##OEROOT##/meta-virtualization \
#
```

## conf/layer.conf
```bitbake
# We have a conf and classes directory, add to BBPATH
BBPATH =. "${LAYERDIR}:"

# We have recipes-* directories, add to BBFILES
BBFILES += "${LAYERDIR}/recipes-*/*/*.bb \
            ${LAYERDIR}/recipes-*/*/*.bbappend"

BBFILE_COLLECTIONS += "emagii"
BBFILE_PATTERN_emagii = "^${LAYERDIR}/"
BBFILE_PRIORITY_emagii = "99"

LAYERSERIES_COMPAT_emagii = "kirkstone"

# This should only be incremented on significant changes that will
# cause compatibility issues with other layers
LAYERVERSION_emagii = "1"

REQUIRED_POKY_BBLAYERS_CONF_VERSION = "2"
```
